/*************************************************************************/
/******************** Interrupt of Left Encoder  *************************/
/*************************************************************************/
void readEncoderL()
{
  ReadingL = digitalRead(ENCB1);
  if (ReadingL > 0)
  {
    pos_l++;
  }
  else
  {
    pos_l--;
  }

  if (pos_l%400 == 0)
    {
     // pos_l = 0;
      stepDone = 1;
    }
}

/*************************************************************************/
/******************** Interrupt of Right Encoder  *************************/
/*************************************************************************/
void readEncoderR()
{
  ReadingR = digitalRead(ENCB);
  if (ReadingR > 0)
  {
    pos_r++;
  }
  else
  {
    pos_r--;
  }
  
  if (pos_r%300 == 0)
    {
     // pos_r = 0;
      stepDone = 1;
    }
}
